## Kconfig
```kconfig
# SPDX-FileCopyrightText: 2026 roolrz
# SPDX-License-Identifier: Apache-2.0

config SYSTEM_APP_SVC_BOOTSTRAP_RETIRE
    bool "svc/bootstrap-retire (/svc/bootstrap-retire)"
    default y
    depends on SYSTEM_APP_COMPONENT_MANAGER
    help
        Build and deploy hyper-bootstrap-retire at /svc/bootstrap-retire.
```
